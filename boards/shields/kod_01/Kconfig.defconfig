## boards/shields/kod_01/Kconfig.defconfig
```kconfig
# Kconfig.defconfig for kod_01

# 右側がCentralなので、右側にキーボード名を設定
if SHIELD_KOD_01_RIGHT

config ZMK_KEYBOARD_NAME
    default "kod_01"

config ZMK_SPLIT_ROLE_CENTRAL
    default y

endif # SHIELD_KOD_01_RIGHT


if SHIELD_KOD_01_LEFT || SHIELD_KOD_01_RIGHT

config ZMK_SPLIT
    default y

endif # SHIELD_KOD_01_LEFT || SHIELD_KOD_01_RIGHT
```

## boards/shields/kod_01/Kconfig.shield
```kconfig
config SHIELD_KOD_01_LEFT
    def_bool $(shields_list_contains,kod_01_left)
config SHIELD_KOD_01_RIGHT
    def_bool $(shields_list_contains,kod_01_right)
```

## config/west.yml
```yaml
manifest:
  remotes:
    - name: zmkfirmware
      url-base: https://github.com/zmkfirmware
    - name: sekigon-gonnoc
      url-base: https://github.com/sekigon-gonnoc
    - name: prospector
      url-base: https://github.com/t-ogura
  projects:
    - name: zmk
      remote: zmkfirmware
      revision: main
      import: app/west.yml
    - name: zmk-driver-paw3222
      remote: sekigon-gonnoc
      revision: main
    - name: prospector-zmk-module
      remote: prospector
      revision: v1.0.0
      path: modules/prospector-zmk-module
  self:
    path: config
```
